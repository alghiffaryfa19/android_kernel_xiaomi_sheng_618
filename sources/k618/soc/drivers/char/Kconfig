## sources/k618/soc/drivers/char/Kconfig
```kconfig
# SPDX-License-Identifier: GPL-2.0
#
# Character device configuration
#

menu "Character devices"

config MSM_RDBG
	tristate "QTI Remote debug driver"
	help
	Implements a shared memory based transport mechanism that allows
	for a debugger running on a host PC to communicate with a remote
	stub running on peripheral subsystems such as the ADSP, MODEM etc.
		Say M if you want to enable this module.

endmenu

# from Xiaomi's 13 Pro tree (5.15)
config XLOGCHAR
    tristate "xlogchar driver"
    help
      Implements a high performance log driver
```

## sources/k618/soc/drivers/input/fingerprint/goodix_fod/Kconfig
```kconfig
# from Xiaomi's 13 Pro tree (5.15)
config FINGERPRINT_GOODIX_FOD
	tristate "Finger print card goodix"
	depends on INPUT_FINGERPRINT
	help
	  Say Y here to enable support for retrieving self-test reports.

	  If unsure, say N.

	  To compile this driver as a module, choose M here.
```

## sources/k618/soc/drivers/soc/qcom/tmecom/Kconfig
```kconfig
# from Xiaomi's 13 Pro tree (5.15)
config MSM_TMECOM_QMP
	tristate "TMECom QMP interface for HWKM master"
	select MSM_QMP
	help
        Set to enable TMECom interface over QTI Mailbox
        Protocol (QMP) for HWKM master on MSM platform.
```
